## nemu/Kconfig
```kconfig
mainmenu "NEMU Configuration Menu"

choice
  prompt "Base ISA"
  default ISA_riscv32
config ISA_x86
  bool "x86"
config ISA_mips32
  bool "mips32"
config ISA_riscv32
  bool "riscv32"
config ISA_riscv64
  bool "riscv64"
endchoice

config ISA
  string
  default "x86" if ISA_x86
  default "mips32" if ISA_mips32
  default "riscv32" if ISA_riscv32
  default "riscv64" if ISA_riscv64
  default "none"

config ISA64
  depends on ISA_riscv64
  bool
  default y


choice
  prompt "NEMU execution engine"
  default ENGINE_INTERPRETER

config ENGINE_INTERPRETER
  bool "Interpreter"
  help
    Interpreter guest instructions one by one.
endchoice

config ENGINE
  string
  default "interpreter" if ENGINE_INTERPRETER
  default "none"

choice
  prompt "Running mode"
  default MODE_SYSTEM

config MODE_SYSTEM
  bool "System mode"
  help
    Support full-system functionality, including privileged instructions, MMU and devices.
endchoice

choice
  prompt "Build target"
  default TARGET_NATIVE_ELF
config TARGET_NATIVE_ELF
  bool "Executable on Linux Native"
config TARGET_SHARE
  bool "Shared object (used as REF for differential testing)"
config TARGET_AM
  bool "Application on Abstract-Machine (DON'T CHOOSE)"
endchoice

menu "Build Options"
choice
  prompt "Compiler"
  default CC_GCC
config CC_GCC
  bool "gcc"
config CC_GPP
  bool "g++"
config CC_CLANG
  depends on !TARGET_AM
  bool "clang"
endchoice

config CC
  string
  default "gcc" if CC_GCC
  default "g++" if CC_GPP
  default "clang" if CC_CLANG
  default "none"

choice
  prompt "Optimization Level"
  default CC_O2
config CC_O0
  bool "O0"
config CC_O1
  bool "O1"
config CC_O2
  bool "O2"
config CC_O3
  bool "O3"
endchoice

config CC_OPT
  string
  default "-O0" if CC_O0
  default "-O1" if CC_O1
  default "-O2" if CC_O2
  default "-O3" if CC_O3
  default "none"

config CC_LTO
  depends on !TARGET_AM
  bool "Enable link-time optimization"
  default n

config CC_DEBUG
  bool "Enable debug information"
  default n

config CC_ASAN
  depends on MODE_SYSTEM
  bool "Enable address sanitizer"
  default n
endmenu

menu "Testing and Debugging"

config FTRACE
  bool "Enable tracer for functions"
  default n

config DTRACE
  bool "Enable tracer for devices"
  default n

config SERIAL
  depends on DTRACE
  bool "Enable the tracer for serial"
  default n

config TIMER
  depends on DTRACE
  bool "Enable the tracer for timer"
  default n

config KEYBOARD
  depends on DTRACE
  bool "Enable the tracer for keyboard"
  default n

config VGA
  depends on DTRACE
  bool "Enable the tracer for vga"
  default n

config VMEM
  depends on DTRACE
  bool "Enable the tracer for display memory"
  default n

config AUDIO
  depends on DTRACE
  bool "Enable the tracer for audio"
  default n

config DISK
  depends on DTRACE
  bool "Enable the tracer for disk"
  default n

config SDCARD
  depends on DTRACE
  bool "Enable the tracer for sdcard"
  default n

config DTRACE_DIRECT
  depends on DTRACE
  bool "Trace all devices when the condition is true"
  default n

config ITRACE
  bool "Enable instruction tracer"
  default n

config ITRACE_START
  depends on ITRACE
  hex "When tracing is enabled (unit: PC of instructions)"
  default 0x80000000

config ITRACE_END
  depends on ITRACE
  hex "When tracing is disabled (unit: PC of instructions)"
  default 0x80000000

config ITRACE_COND
  depends on ITRACE
  bool "Only trace instructions when the condition is true"
  default y

config ITRACE_DIRECT
  depends on ITRACE
  bool "Trace all instructions when the condition is true"
  default n

config ETRACE
  bool "Enable tracer for exceptions"
  default n

config ECALL_CAUSE
  depends on ETRACE
  bool "Enable the tracer for ecall"
  default y

config ETRACE_START
  depends on ETRACE
  hex "Which insts' exception tracing are enabled"
  default 0x0

config ETRACE_END
  depends on ETRACE
  hex "Which insts' exceptions tracing are disabled"
  default 0x0

config ETRACE_COND
  depends on ETRACE
  bool "Only trace exceptions when the condition is true"
  default y

config ETRACE_DIRECT
  depends on ETRACE
  bool "Trace all exceptions"
  default n

config MTRACE
  bool "Enable tracer for memory"
  default n

config PMTRACE_START
  depends on MTRACE
  hex "Which addresses of memory tracing are enabled (unit: start physical address of memory)"
  default 0x0

config PMTRACE_END
  depends on MTRACE
  hex "Which addresses of memory tracing are disabled (unit: end physical address of memory)"
  default 0x0

config MTRACE_COND
  depends on MTRACE
  bool "Only trace memory when the condition is true"
  default y

config MTRACE_DIRECT
  depends on MTRACE
  bool "Trace all memory when the condition is true"
  default n

config WATCHPOINTS
  bool "Enable checking for watchpoints"
  default n

config DIFFTEST
  depends on TARGET_NATIVE_ELF
  bool "Enable differential testing"
  default n
  help
    Enable differential testing with a reference design.
    Note that this will significantly reduce the performance of NEMU.

choice
  prompt "Reference design"
  default DIFFTEST_REF_SPIKE if ISA_riscv64 || ISA_riscv32
  default DIFFTEST_REF_KVM if ISA_x86
  default DIFFTEST_REF_QEMU
  depends on DIFFTEST
config DIFFTEST_REF_QEMU
  bool "QEMU, communicate with socket"
if ISA_riscv64 || ISA_riscv32
config DIFFTEST_REF_SPIKE
  bool "Spike"
endif
if ISA_x86
config DIFFTEST_REF_KVM
  bool "KVM"
endif
endchoice

config DIFFTEST_REF_PATH
  string
  default "tools/qemu-diff" if DIFFTEST_REF_QEMU
  default "tools/kvm-diff" if DIFFTEST_REF_KVM
  default "tools/spike-diff" if DIFFTEST_REF_SPIKE
  default "none"

config DIFFTEST_REF_NAME
  string
  default "qemu" if DIFFTEST_REF_QEMU
  default "kvm" if DIFFTEST_REF_KVM
  default "spike" if DIFFTEST_REF_SPIKE
  default "none"
endmenu

if MODE_SYSTEM
source "src/memory/Kconfig"
source "src/device/Kconfig"
endif


menu "Miscellaneous"
choice
  depends on !TARGET_AM
  prompt "Host timer"
  default TIMER_GETTIMEOFDAY
config TIMER_GETTIMEOFDAY
  bool "gettimeofday"
config TIMER_CLOCK_GETTIME
  bool "clock_gettime"
endchoice

config RT_CHECK
  bool "Enable runtime checking"
  default y

endmenu
```
